/ {
	ocp {
		pruss@4A300000 {
			compatible = "ti,pruss-v2";
			reg = <0x4A300000 0x80000>;
 			interrupt-parent = <&intc>;
			interrupts = <20 21 22 23 24 25 26 27>;
		};

	};

};

&tps {
	interrupt-parent = <&intc>;
	interrupts = <7>;
};
